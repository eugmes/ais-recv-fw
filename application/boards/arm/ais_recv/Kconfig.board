## application/hdlc/Kconfig
```kconfig
config HDLC
	bool "HDLC support"
	help
	  Add support for decoding of syncronous HDLC packets.

if HDLC

module = HDLC
module-str = hdlc
source "subsys/logging/Kconfig.template.log_config"

endif
```

## application/hdlc/tests/testcase.yaml
```yaml
tests:
  libraries.hdlc:
    tags: hdlc
    timeout: 10
    platform_allow: mps2_an521 mps2_an385 qemu_cortex_m0
```
